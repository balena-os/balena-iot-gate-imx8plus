## layers/meta-balena-imx8mp/conf/layer.conf
```bitbake
BBPATH .= ":${LAYERDIR}"

BBFILES += "${LAYERDIR}/recipes-*/*/*.bb \
            ${LAYERDIR}/recipes-*/*/*.bbappend"

BBFILE_COLLECTIONS += "balena-imx8mp"
BBFILE_PATTERN_balena-imx8mp := "^${LAYERDIR}/"
BBFILE_PRIORITY_balena-imx8mp = "1337"
LAYERSERIES_COMPAT_balena-imx8mp = "kirkstone"

BBMASK += "compulab-qt5-build-env.bb"
BBMASK += "meta-compulab-bsp/meta-bsp/recipes-bsp/base-files/"
BBMASK += "meta-compulab/recipes-core/systemd/"
```

## layers/meta-balena-imx8mplus/conf/layer.conf
```bitbake
BBPATH .= ":${LAYERDIR}"

BBFILES += "${LAYERDIR}/recipes-*/*/*.bb \
            ${LAYERDIR}/recipes-*/*/*.bbappend"

BBFILE_COLLECTIONS += "balena-imx8mplus"
BBFILE_PATTERN_balena-imx8mplus := "^${LAYERDIR}/"
BBFILE_PRIORITY_balena-imx8mplus = "1337"
LAYERSERIES_COMPAT_balena-imx8mplus = "kirkstone"

# 4.4.2.20 not yet available in meta-freescale
BBMASK += "meta-imx8mp-isp-imx219/recipes-kernel/kernel-modules"
# No longer available in meta-freescale
BBMASK += "meta-imx/meta-bsp/recipes-bsp/u-boot/u-boot-imx-tools_2021.04.bb"
BBMASK += "meta-bsp-imx8mp/recipes-nxp-demo-experience/nxp-demo-experience"
BBMASK += "meta-compulab-bsp/meta-bsp/recipes-bsp/base-files"
BBMASK += "meta-compulab-bsp/meta-bsp/recipes-bsp/coremark"
BBMASK += "meta-compulab-bsp/meta-bsp/recipes-bsp/systemd"
BBMASK += "meta-compulab-bsp/meta-bsp/recipes-bsp/wpa-supplicant"
BBMASK += "meta-compulab-bsp/meta-bsp/recipes-bsp/u-boot-ai-script"
BBMASK += "meta-compulab-bsp/meta-bsp/recipes-bsp/u-boot-scr"
BBMASK += "meta-compulab-bsp/meta-bsp/recipes-bsp/u-boot-update-scr"

# Mask meta-balena-hab recipes for other SOM families
BBMASK += "meta-balena-hab/recipes-bsp/u-boot/u-boot-variscite.bbappend"
BBMASK += "meta-balena-hab/recipes-kernel/linux/linux-variscite_%.bbappend"

KERNEL_IMAGETYPE:iot-gate-imx8plus = "Image.gz"
KERNEL_PACKAGE_NAME="kernel"

KERNEL_DEVICETREE:iot-gate-imx8plus = " \
       compulab/iot-gate-imx8plus.dtb \
       compulab/iot-gate-imx8plus-usbdev.dtb \
       compulab/iot-gate-imx8plus-m2tpm.dtb \
"

DRAM_CONF:iot-gate-imx8plus="d2d4"
DRAM_CONF:iot-gate-imx8plus-d1d8="d1d8"

EARLY_SERIAL_CONSOLE:iot-gate-imx8plus="ec_imx6q,0x30890000,115200"
EARLY_SERIAL_CONSOLE:iot-gate-imx8plus-d1d8="ec_imx6q,0x30890000,115200"

HOSTTOOLS:remove = " git-lfs "
HOSTTOOLS:remove = " bison "
MACHINE_FEATURES:remove = "optee-os"
MACHINE_FEATURES:remove = "efi"

# This is the version provided by the poky
# revision for the 5.15 kernel revision, as per https://github.com/nxp-imx/imx-manifest/blob/imx-linux-kirkstone/imx-5.15.32-2.0.0.xml
# Can be dropped after updating to a newer kernel which
# is in sync with the wireless regdb provided by Poky
PREFERRED_VERSION:wireless-regdb = "2022.04.08"
```

## layers/meta-balena-imx8mplus/conf/machine/iot-gate-imx8plus-d1d8.conf
```bitbake
#@TYPE: Machine
#@NAME: CompuLab IOT-GATE-IMX8PLUS-D1D8 - Industrial IoT Gateway
#@SOC: i.MX8MM
#@DESCRIPTION: Machine configuration for IOT-GATE-IMX8PLUS D1D8

MACHINEOVERRIDES =. "iot-gate-imx8plus:${MACHINE}:"

include conf/machine/iot-gate-imx8plus.conf
```
